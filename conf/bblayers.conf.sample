## conf/bblayers.conf.sample
```bitbake
# POKY_BBLAYERS_CONF_VERSION is increased each time build/conf/bblayers.conf
# changes incompatibly
POKY_BBLAYERS_CONF_VERSION = "2"

BBPATH = "${TOPDIR}"
PRBASE = "${TOPDIR}/../.."
BBFILES ?= ""

BBLAYERS ?= " \
    ${PRBASE}/poky-dunfell/meta \
    ${PRBASE}/poky-dunfell/meta-poky \
    ${PRBASE}/poky-dunfell/meta-openembedded/meta-oe \
    ${PRBASE}/poky-dunfell/meta-openembedded/meta-multimedia \
    ${PRBASE}/poky-dunfell/meta-openembedded/meta-networking \
    ${PRBASE}/poky-dunfell/meta-openembedded/meta-perl \
    ${PRBASE}/poky-dunfell/meta-openembedded/meta-python \
    ${PRBASE}/poky-dunfell/meta-qt5 \
    ${PRBASE}/poky-dunfell/meta-raspberrypi \
    ${PRBASE}/poky-dunfell/meta-security \
    ${PRBASE}/poky-dunfell/meta-jumpnow \
    ${PRBASE}/rpi/meta-rpi \
"
```
